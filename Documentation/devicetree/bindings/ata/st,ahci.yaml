## Documentation/devicetree/bindings/display/st,stih4xx.txt
```
STMicroelectronics stih4xx platforms


- sti-vtac: video timing advanced inter dye communication Rx and TX
  Required properties:
  - compatible: "st,vtac-main" or "st,vtac-aux"
  - reg: Physical base address of the IP registers and length of memory mapped region.
  - clocks: from common clock binding: handle hardware IP needed clocks, the
    number of clocks may depend of the SoC type.
    See ../clocks/clock-bindings.txt for details.
  - clock-names: names of the clocks listed in clocks property in the same
    order.

####################################################################################

title: STMicroelectronics STi DRM master device

maintainers:
  - Patrice Chotard <patrice.chotard@foss.st.com>
  - Alain Volmat <alain.volmat@foss.st.com>
  - Raphaël Gallais-Pou <rgallaispou@gmail.com>

description: |
  The STMicroelectronics STi DRM master device is a virtual device needed to
  list all the display interface nodes that encapsulate the graphics subsystem.

  The STMicroelectronics STiH SoCs use a common chain of HW display IP blocks:
  - The High Quality Video Display Processor (HQVDP) gets video frames from a
    video decoder and does high quality video processing, including scaling.
  - The Compositor is a multiplane, dual-mixer (Main & Aux) digital processor. It
    has several inputs:
    - The graphics planes are internally processed by the Generic Display
      Pipeline (GDP).
    - The video plug (VID) connects to the HQVDP output.
    - The cursor handles ... a cursor.
  - The TV OUT pre-formats (convert, clip, round) the compositor output data
  - The HDMI / DVO / HD Analog / SD analog IP builds the video signals
    - DVO (Digital Video Output) handles a 24bits parallel signal
    - The HD analog signal is typically driven by a YCbCr cable, supporting up to
      1080i mode.
    - The SD analog signal is typically used for legacy TV
  - The VTG (Video Timing Generators) build Vsync signals used by the other HW IP
  Note that some stiH drivers support only a subset of thee HW IP.

                    .-------------.   .-----------.   .-----------.
  GPU >-------------+GDP     Main |   |           +---+    HDMI   +--> HDMI
  GPU >-------------+GDP     mixer+---+           |   :===========:
  GPU >-------------+Cursor       |   |           +---+    DVO    +--> 24b//
          -------   |  COMPOSITOR |   |  TV OUT   |   :===========:
         |       |  |             |   |           +---+ HD analog +--> YCbCr
  Vid >--+ HQVDP +--+VID     Aux  +---+           |   :===========:
  dec    |       |  |        mixer|   |           +---+ SD analog +--> CVBS
         '-------'  '-------------'   '-----------'   '-----------'
                     .-----------.
                     |       main+--> Vsync
                     | VTG       |
                     |        aux+--> Vsync
                     '-----------'

  These IP are mapped to the DRM objects as following:
  - The CRTCs are mapped to the Compositor Main and Aux Mixers
  - The Framebuffers and planes are mapped to the Compositor GDP (non video
    buffers) and to HQVDP+VID (video buffers)
  - The Cursor is mapped to the Compositor Cursor
  - The Encoders are mapped to the TVOut
  - The Bridges/Connectors are mapped to the HDMI / DVO / HD Analog / SD analog

  FB & planes         Cursor      CRTC     Encoders    Bridges/Connectors
     |                   |          |         |                       |
     |                   |          |         |                       |
     |              .-------------. | .-----------.   .-----------.   |
     +------------> |GDP |   Main | | |       +-> |   |    HDMI   | <-+
     +------------> |GDP v   mixer|<+ |       |   |   :===========:   |
     |              |Cursor       | | |       +-> |   |    DVO    | <-+
     |    -------   |  COMPOSITOR | | |TV OUT |   |   :===========:   |
     |   |       |  |             | | |       +-> |   | HD analog | <-+
     +-> | HQVDP |  |VID     Aux  |<+ |       |   |   :===========:   |
         |       |  |        mixer|   |       +-> |   | SD analog | <-+
         '-------'  '-------------'   '-----------'   '-----------'

properties:
  compatible:
    const: st,sti-display-subsystem

  ports:
    $ref: /schemas/types.yaml#/definitions/phandle-array
    items:
      maxItems: 1
    description: |
      Should contain a list of phandles pointing to display interface port
      of display controller devices.

required:
  - compatible
  - ports
  - ranges: to allow probing of subdevices ???

additionalProperties: false

examples:
  - |
    display-subsystem {
        compatible = "st,sti-display-subsystem";
        ports = <&display_compositor>;
    };

####################################################################################
- sti-compositor: 
  must be a child of sti-display-subsystem

title: STMicroelectronics STi DRM compositor device

maintainers:
  - Patrice Chotard <patrice.chotard@foss.st.com>
  - Alain Volmat <alain.volmat@foss.st.com>

description: |
	frame compositor engine
  The Compositor is a multiplane, dual-mixer (Main & Aux) digital processor. It
      has several inputs:
      - The graphics planes are internally processed by the Generic Display
        Pipeline (GDP).
      - The video plug (VID) connects to the HQVDP output.
      - The cursor handles ... a cursor.

properties:
  compatible:
    const: st,sti407-compositor

  reg:
    maxItems: 1

  clocks:
    maxItems: 10

  clock-names:
    items:
      - const: compo_main
      - const: compo_aux
      - const: pix_main
      - const: pix_aux
      - const: pix_gdp1
      - const: pix_gdp2
      - const: pix_gdp3
      - const: pix_gdp4
      - const: main_parent
      - const: aux_parent

  resets:
    maxItems: 2

  reset-names:
    items:
      - const: compo-main
      - const: compo-aux

  st,vtg:
    description: phandle(s) on vtg device (main and aux) nodes.

required:
  - compatible
  - reg
  - clocks
  - clock-names
  - resets
  - reset-names
  - ports
  - st,vtg ??

additionalProperties: false

examples:
  - |
	TODO
####################################################################################

title: STMicroelectronics STi video out hardware block device

maintainers:
  - Patrice Chotard <patrice.chotard@foss.st.com>
  - Alain Volmat <alain.volmat@foss.st.com>

description: |
	TODO sti-tvout video out hardware block

properties:
  compatible:
    const: st,sti407-tvout

  reg:
    maxItems: 1

  resets:
    maxItems: 1

  reset-names:
    items:
      - const: tvout

required:
  - compatible
  - reg
  - resets
  - reset-names
  - ports ???

  Required properties:
  - resets: resets to be used by the device
    See ../reset/reset.txt for details.
  - reset-names: names of the resets listed in resets property in the same
    order.
####################################################################################

title: STMicroelectronics STi HDMI output block device

maintainers:
  - Patrice Chotard <patrice.chotard@foss.st.com>
  - Alain Volmat <alain.volmat@foss.st.com>

description: |
	TODO sti-hdmi: hdmi output block

properties:
  compatible:
    const: st,sti407-hdmi

  reg:
    maxItems: 1

  clocks:
    maxItems: 6

  clock-names:
    items:
      - const: pix
      - const: tmds
      - const: phy
      - const: audio
      - const: main_parent
      - const: aux_parent

  resets:
    maxItems: 1

  reset-names:
    - const: hdmi

required:
  - compatible
  - reg
  - reg-name
  - interrupts
  - interrupt-names
  - resets
  - reset-names
  - ports ???
  - ddc ??

  - ddc: phandle of an I2C controller used for DDC EDID probing
####################################################################################

sti-hda:
  Required properties:
  - compatible: "st,stih<chip>-hda"
  - reg: Physical base address of the IP registers and length of memory mapped region.
  - reg-names: names of the mapped memory regions listed in regs property in
    the same order.
  - clocks: from common clock binding: handle hardware IP needed clocks, the
    number of clocks may depend of the SoC type.
    See ../clocks/clock-bindings.txt for details.
  - clock-names: names of the clocks listed in clocks property in the same
    order.
####################################################################################

sti-dvo:
  Required properties:
  - compatible: "st,stih<chip>-dvo"
  - reg: Physical base address of the IP registers and length of memory mapped region.
  - reg-names: names of the mapped memory regions listed in regs property in
    the same order.
  - clocks: from common clock binding: handle hardware IP needed clocks, the
    number of clocks may depend of the SoC type.
    See ../clocks/clock-bindings.txt for details.
  - clock-names: names of the clocks listed in clocks property in the same
    order.
  - pinctrl-0: pin control handle
  - pinctrl-names: names of the pin control states to use
  - sti,panel: phandle of the panel connected to the DVO output
####################################################################################

sti-hqvdp:
  Required properties:
  - compatible: "st,stih<chip>-hqvdp"
  - reg: Physical base address of the IP registers and length of memory mapped region.
  - clocks: from common clock binding: handle hardware IP needed clocks, the
    number of clocks may depend of the SoC type.
    See ../clocks/clock-bindings.txt for details.
  - clock-names: names of the clocks listed in clocks property in the same
    order.
  - resets: resets to be used by the device
    See ../reset/reset.txt for details.
  - reset-names: names of the resets listed in resets property in the same
    order.
  - st,vtg: phandle on vtg main device node.

Example:

/ {
	...

	vtg_main_slave: sti-vtg-main-slave@fe85a800 {
		compatible	= "st,vtg";
		reg		= <0xfe85A800 0x300>;
		interrupts	= <GIC_SPI 175 IRQ_TYPE_NONE>;
	};

	vtg_main: sti-vtg-main-master@fd348000 {
		compatible	= "st,vtg";
		reg		= <0xfd348000 0x400>;
		st,slave	= <&vtg_main_slave>;
	};

	vtg_aux_slave: sti-vtg-aux-slave@fd348400 {
		compatible	= "st,vtg";
		reg		= <0xfe858200 0x300>;
		interrupts	= <GIC_SPI 176 IRQ_TYPE_NONE>;
	};

	vtg_aux: sti-vtg-aux-master@fd348400 {
		compatible	= "st,vtg";
		reg		= <0xfd348400 0x400>;
		st,slave	= <&vtg_aux_slave>;
	};


	sti-vtac-rx-main@fee82800 {
		compatible	= "st,vtac-main";
		reg		= <0xfee82800 0x200>;
		clock-names     = "vtac";
		clocks          = <&clk_m_a2_div0 CLK_M_VTAC_MAIN_PHY>;
	};

	sti-vtac-rx-aux@fee82a00 {
		compatible	= "st,vtac-aux";
		reg		= <0xfee82a00 0x200>;
		clock-names     = "vtac";
		clocks          = <&clk_m_a2_div0 CLK_M_VTAC_AUX_PHY>;
	};

	sti-vtac-tx-main@fd349000 {
		compatible	= "st,vtac-main";
		reg		= <0xfd349000 0x200>, <0xfd320000 0x10000>;
		clock-names     = "vtac";
		clocks           = <&clk_s_a1_hs CLK_S_VTAC_TX_PHY>;
	};

	sti-vtac-tx-aux@fd349200 {
		compatible	= "st,vtac-aux";
		reg		= <0xfd349200 0x200>, <0xfd320000 0x10000>;
		clock-names     = "vtac";
		clocks          = <&clk_s_a1_hs CLK_S_VTAC_TX_PHY>;
	};

	sti-display-subsystem {
		compatible = "st,sti-display-subsystem";
		ranges;

		sti-compositor@fd340000 {
			compatible	= "st,stih416-compositor";
			reg		= <0xfd340000 0x1000>;
			clock-names	= "compo_main", "compo_aux",
			                  "pix_main", "pix_aux";
			clocks          = <&clk_m_a2_div1 CLK_M_COMPO_MAIN>, <&clk_m_a2_div1 CLK_M_COMPO_AUX>,
					  <&clockgen_c_vcc CLK_S_PIX_MAIN>, <&clockgen_c_vcc CLK_S_PIX_AUX>;
			reset-names     = "compo-main", "compo-aux";
			resets          = <&softreset STIH416_COMPO_M_SOFTRESET>, <&softreset STIH416_COMPO_A_SOFTRESET>;
			st,vtg		= <&vtg_main>, <&vtg_aux>;
		};

		sti-tvout@fe000000 {
			compatible	= "st,stih416-tvout";
			reg		= <0xfe000000 0x1000>, <0xfe85a000 0x400>, <0xfe830000 0x10000>;
			reg-names	= "tvout-reg", "hda-reg", "syscfg";
			reset-names     = "tvout";
			resets          = <&softreset STIH416_HDTVOUT_SOFTRESET>;
		};

		sti-hdmi@fe85c000 {
			compatible	= "st,stih416-hdmi";
			reg		= <0xfe85c000 0x1000>, <0xfe830000 0x10000>;
			reg-names	= "hdmi-reg", "syscfg";
			interrupts	= <GIC_SPI 173 IRQ_TYPE_NONE>;
			interrupt-names	= "irq";
			clock-names	= "pix", "tmds", "phy", "audio";
			clocks          = <&clockgen_c_vcc CLK_S_PIX_HDMI>, <&clockgen_c_vcc CLK_S_TMDS_HDMI>, <&clockgen_c_vcc CLK_S_HDMI_REJECT_PLL>, <&clockgen_b1 CLK_S_PCM_0>;
		};

		sti-hda@fe85a000 {
			compatible	= "st,stih416-hda";
			reg		= <0xfe85a000 0x400>, <0xfe83085c 0x4>;
			reg-names	= "hda-reg", "video-dacs-ctrl";
			clock-names	= "pix", "hddac";
			clocks          = <&clockgen_c_vcc CLK_S_PIX_HD>, <&clockgen_c_vcc CLK_S_HDDAC>;
		};

		sti-dvo@8d00400 {
			compatible	= "st,stih407-dvo";
			reg		= <0x8d00400 0x200>;
			reg-names	= "dvo-reg";
			clock-names	= "dvo_pix", "dvo",
					  "main_parent", "aux_parent";
			clocks		= <&clk_s_d2_flexgen CLK_PIX_DVO>, <&clk_s_d2_flexgen CLK_DVO>,
					  <&clk_s_d2_quadfs 0>, <&clk_s_d2_quadfs 1>;
			pinctrl-names	= "default";
			pinctrl-0	= <&pinctrl_dvo>;
			sti,panel	= <&panel_dvo>;
		};

		sti-hqvdp@9c000000 {
				compatible	= "st,stih407-hqvdp";
				reg		= <0x9C00000 0x100000>;
				clock-names	= "hqvdp", "pix_main";
				clocks		= <&clk_s_c0_flexgen CLK_MAIN_DISP>, <&clk_s_d2_flexgen CLK_PIX_MAIN_DISP>;
				reset-names     = "hqvdp";
				resets          = <&softreset STIH407_HDQVDP_SOFTRESET>;
				st,vtg		= <&vtg_main>;
		};
	};
	...
};
```

## Documentation/devicetree/bindings/display/st,vtg.yaml
```yaml
# SPDX-License-Identifier: (GPL-2.0-only OR BSD-2-Clause)
%YAML 1.2
---
$id: http://devicetree.org/schemas/display/st,vtg.yaml#
$schema: http://devicetree.org/meta-schemas/core.yaml#


title: STMicroelectronics STi Video Timing Generator device

maintainers:
  - Patrice Chotard <patrice.chotard@foss.st.com>
  - Alain Volmat <alain.volmat@foss.st.com>

description: |
  The VTG (Video Timing Generators) devices build Vsync signals used by the
  other HW IP.

properties:
  compatible:
    const: st,vtg

  reg:
    maxItems: 1

  interrupts:
    maxItems: 1

required:
  - compatible
  - reg

additionalProperties: false

examples:
  - |
    vtg@8d02800 {
        compatible = "st,vtg";
        reg = <0x8d02800 0x200>;
        interrupts = <GIC_SPI 108 IRQ_TYPE_LEVEL_HIGH>;
    };
```

## Documentation/devicetree/bindings/pwm/st,sti-pwm.yaml
```yaml
# SPDX-License-Identifier: (GPL-2.0-only OR BSD-2-Clause)
%YAML 1.2
---
$id: http://devicetree.org/schemas/pwm/st,sti-pwm.yaml#
$schema: http://devicetree.org/meta-schemas/core.yaml#

title: STMicroelectronics STi PWM controller

maintainers:
  - Patrice Chotard <patrice.chotard@foss.st.com>

allOf:
  - $ref: pwm.yaml#

properties:
  compatible:
    const: st,sti-pwm

  reg:
    maxItems: 1

  interrupts:
    maxItems: 1

  pinctrl-names:
    const: default

  pinctrl-0:
    description: Configuration for the default state.

  clock-names:
    const: pwm

  clocks:
    $ref: "/schemas/types.yaml#/definitions/phandle"

  st,pwm-num-chan:
    $ref: "/schemas/types.yaml#/definitions/uint32"
    description: Number of available PWM channels.

  st,capture-num-chan:
    $ref: "/schemas/types.yaml#/definitions/uint32"
    description: Number of available Capture channels.

  "#pwm-cells":
    const: 2

required:
  - compatible
  - reg
  - interrupts
  - clock-names
  - clocks

additionalProperties: false

examples:
  - |
        pwm1: pwm@9510000 {
            compatible = "st,sti-pwm";
            #pwm-cells = <2>;
            reg = <0x9510000 0x68>;
            interrupts = <GIC_SPI 131 IRQ_TYPE_LEVEL_HIGH>;
            pinctrl-names = "default";
            pinctrl-0 = <&pinctrl_pwm1_chan0_default
                     &pinctrl_pwm1_chan1_default
                     &pinctrl_pwm1_chan2_default
                     &pinctrl_pwm1_chan3_default>;
            clock-names = "pwm";
            clocks = <&clk_sysin>;
            st,pwm-num-chan = <4>;
        };
...
```
