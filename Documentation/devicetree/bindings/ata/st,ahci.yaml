## Documentation/devicetree/bindings/ata/st,ahci.yaml
```yaml
# SPDX-License-Identifier: (GPL-2.0-only OR BSD-2-Clause)
%YAML 1.2
---
$id: http://devicetree.org/schemas/ata/st,ahci.yaml#
$schema: http://devicetree.org/meta-schemas/core.yaml#

title: STMicroelectronics STi SATA controller

maintainers:
  - Patrice Chotard <patrice.chotard@foss.st.com>

properties:
  compatible:
    const: st,ahci

  reg:
    maxItems: 1

  interrupts:
    maxItems: 1

  interrupt-names:
    const: hostc

  clocks:
    maxItems: 1

  clock-names:
    const: ahci_clk

  phys:
    maxItems: 1

  phy-names:
    const: ahci_phy

  resets:
    maxItems: 3

  reset-names:
    items:
      - const: pwr-dwn
      - const: sw-rst
      - const: pwr-rst

required:
  - compatible
  - reg
  - interrupts
  - interrupt-names
  - clocks
  - clock-names
  - phys
  - phy-names

additionalProperties: false

examples:
  - |
    /* Example for stih407 family silicon */
    sata0: sata@9b20000 {
        compatible    = "st,ahci";
        reg        = <0x9b20000 0x1000>;
        interrupts    = <GIC_SPI 159 IRQ_TYPE_NONE>;
        interrupt-names    = "hostc";
        phys        = <&phy_port0 PHY_TYPE_SATA>;
        phy-names    = "ahci_phy";
        resets        = <&powerdown STIH407_SATA0_POWERDOWN>,
                  <&softreset STIH407_SATA0_SOFTRESET>,
                  <&softreset STIH407_SATA0_PWR_SOFTRESET>;
        reset-names    = "pwr-dwn", "sw-rst", "pwr-rst";
        clocks        = <&clk_s_c0_flexgen CLK_ICN_REG>;
        clock-names    = "ahci_clk";
    };
...
```

## Documentation/devicetree/bindings/clock/st/st,clkgen-mux.yaml
```yaml
# SPDX-License-Identifier: (GPL-2.0-only OR BSD-2-Clause)
%YAML 1.2
---
$id: http://devicetree.org/schemas/clock/st/st,clkgen-mux.yaml#
$schema: http://devicetree.org/meta-schemas/core.yaml#

title: STMicroelectronics STi platform clockgen multiplexed driver

maintainers:
  - Patrice Chotard <patrice.chotard@foss.st.com>

description: |
  This binding supports only simple indexed multiplexers, it does not
  support table based parent index to hardware value translations.

properties:
  compatible:
    const: st,stih407-clkgen-a9-mux

  clocks:
    description:
      Specifies the reference clock(s) from which the output frequency is
      derived.
    maxItems: 4

  '#clock-cells':
    const: 0 

required:
  - "#clock-cells"
  - compatible
  - clocks

additionalProperties: false

examples:
  - |
    clockgen-a9@92b0000 {
        compatible = "st,clkgen-c32";
        reg = <0x92b0000 0x10000>;
        clk_m_a9: clk-m-a9 {
            #clock-cells = <0>;
            compatible = "st,stih407-clkgen-a9-mux";
            clocks = <&clockgen_a9_pll 0>,
                     <&clockgen_a9_pll 0>,
                     <&clk_s_c0_flexgen 13>,
                     <&clk_m_a9_ext2f_div2>;
        };
    };

...
```

## Documentation/devicetree/bindings/clock/st/st,clkgen-pll.yaml
```yaml
# SPDX-License-Identifier: (GPL-2.0-only OR BSD-2-Clause)
%YAML 1.2
---
$id: http://devicetree.org/schemas/clock/st/st,clkgen-pll.yaml#
$schema: http://devicetree.org/meta-schemas/core.yaml#

title: STMicroelectronics STi platform clockgen PLL

maintainers:
  - Patrice Chotard <patrice.chotard@foss.st.com>

description: |
  This describes the schema of a pll being used as a source for
  the clockgen.

properties:
  compatible:
    enum:
      - st,clkgen-pll0
      - st,clkgen-pll0-a0
      - st,clkgen-pll0-c0
      - st,clkgen-pll1
      - st,clkgen-pll1-c0
      - st,stih407-clkgen-plla9
      - st,stih418-clkgen-plla9

  clocks:
    description:
      Specifies the reference clock(s) from which the output frequency is
      derived.
    maxItems: 1

  '#clock-cells':
    const: 1

  clock-output-names:
    maxItems: 1

required:
  - "#clock-cells"
  - compatible
  - clocks

additionalProperties: false

examples:
  - |
    clockgen-a9@92b0000 {
        compatible = "st,clkgen-c32";
        reg = <0x92b0000 0x10000>;
        clockgen_a9_pll: clockgen-a9-pll {
            #clock-cells = <1>;
            compatible = "st,stih407-clkgen-plla9";
            clocks = <&clk_sysin>;
        };
    };

...
```

## Documentation/devicetree/bindings/clock/st/st,clkgen.yaml
```yaml
# SPDX-License-Identifier: (GPL-2.0-only OR BSD-2-Clause)
%YAML 1.2
---
$id: http://devicetree.org/schemas/clock/st/st,clkgen.yaml#
$schema: http://devicetree.org/meta-schemas/core.yaml#

title: STMicroelectronics STi platform clockgen Clock Controller

maintainers:
  - Patrice Chotard <patrice.chotard@foss.st.com>

description: |
  A Clockgen node can contain pll, diviser or multiplexer nodes.

  We will find only the base address of the Clockgen, this base
  address is common of all subnode.

    clockgen_node {
      reg = <>;

      pll_node {
        ...
      };

      quadfs_node {
        ...
      };

      mux_node {
        ...
      };

      flexgen_node {
        ...
      };
    ...
  };

properties:
  compatible:
    const: st,clkgen-c32

  reg:
    maxItems: 1

patternProperties:
  ".*-pll":
    description:
      PLL generating of the input clock for the flexgen
    type: object
    $ref: /schemas/clock/st/st,clkgen-pll.yaml#

  "clk-m-a9":
    description:
      The A9 clock mux node
    type: object
    $ref: /schemas/clock/st/st,clkgen-mux.yaml#

  ".*-quadfs":
    description:
      Frequency generators, usually used as input by the flexgen
    type: object
    $ref: /schemas/clock/st/st,quadfs.yaml#

  ".*-flexgen":
    description:
      The flexgen getting all input clock and generating
      the child clock via dividers
    type: object
    $ref: /schemas/clock/st/st,flexgen.yaml#

required:
  - compatible
  - reg

additionalProperties: false

examples:
  - |

...
```

## Documentation/devicetree/bindings/clock/st/st,flexgen.yaml
```yaml
# SPDX-License-Identifier: (GPL-2.0-only OR BSD-2-Clause)
%YAML 1.2
---
$id: http://devicetree.org/schemas/clock/st/st,flexgen.yaml#
$schema: http://devicetree.org/meta-schemas/core.yaml#

title: STMicroelectronics STi platform flexgen Clock Controller

maintainers:
  - Patrice Chotard <patrice.chotard@foss.st.com>

description: |
  Binding for a type of flexgen structure found on certain
  STMicroelectronics consumer electronics SoC devices

  This structure includes
    - a clock cross bar (represented by a mux element)
    - a pre and final dividers (represented by a divider and gate elements)

  Please find an example below

      Clockgen block diagram
      -------------------------------------------------------------------
     |                     Flexgen structure                             |
     |                  ---------------------------------------------    |
     |                 |    -------       --------       --------    |   |
  clk_sysin            |   |       |     |        |     |        |   |   |
  ---|-----------------|-->|       |     |        |     |        |   |   |
     | |               |   |       |     |        |     |        |   |   |
     | |   -------     |   |       |     |Pre     |     |Final   |   |   |
     | |  |PLL0   |    |   |       |     |Dividers|     |Dividers|   |   |
     | |->|       |    |   |       |     |  x32   |     |  x32   |   |   |
     | |  |  odf_0|----|-->|       |     |        |     |        |   |   |
     | |  |       |    |   |       |     |        |     |        |   |   |
     | |  |       |    |   |       |     |        |     |        |   |   |
     | |  |       |    |   |       |     |        |     |        |   |   |
     | |  |       |    |   |       |     |        |     |        |   |   |
     | |   -------     |   |       |     |        |     |        |   |   |
     | |               |   |       |     |        |     |        |   |   |
     | |   -------     |   | Clock |     |        |     |        |   |   |
     | |  |PLL1   |    |   |       |     |        |     |        |   |   |
     | |->|       |    |   | Cross |     |        |     |        |   |   |
     | |  |  odf_0|----|-->|       |     |        |     |        | CLK_DIV[31:0]
     | |  |       |    |   | Bar   |====>|        |====>|        |===|=========>
     | |  |       |    |   |       |     |        |     |        |   |   |
     | |  |       |    |   |       |     |        |     |        |   |   |
     | |  |       |    |   |       |     |        |     |        |   |   |
     | |   -------     |   |       |     |        |     |        |   |   |
     | |               |   |       |     |        |     |        |   |   |
     | |   -------     |   |       |     |        |     |        |   |   |
     | |  |QUADFS |    |   |       |     |        |     |        |   |   |
     | |->|    ch0|----|-->|       |     |        |     |        |   |   |
     |    |       |    |   |       |     |        |     |        |   |   |
     |    |    ch1|----|-->|       |     |        |     |        |   |   |
     |    |       |    |   |       |     |        |     |        |   |   |
     |    |    ch2|----|-->|       |     | DIV    |     | DIV    |   |   |
     |    |       |    |   |       |     |  1 to  |     |  1 to  |   |   |
     |    |    ch3|----|-->|       |     |   1024 |     |     64 |   |   |
     |     -------     |   |       |     |        |     |        |   |   |
     |                 |    -------       --------       --------    |   |
     |                   --------------------------------------------    |
     |                                                                   |
      -------------------------------------------------------------------

properties:
  "#clock-cells":
    const: 1

  compatible:
    items:
      - const: st,flexgen
      - enum:
          - st,flexgen-audio
          - st,flexgen-video
          - st,flexgen-stih407-a0
          - st,flexgen-stih407-c0
          - st,flexgen-stih407-d0
          - st,flexgen-stih407-d2
          - st,flexgen-stih407-d3
          - st,flexgen-stih410-a0
          - st,flexgen-stih410-c0
          - st,flexgen-stih410-d0
          - st,flexgen-stih418-c0
          - st,flexgen-stih418-d2

  clocks: true

  clock-output-names:
    description:
      List of strings used to name the clock outputs
    deprecated: true

required:
  - "#clock-cells"
  - compatible
  - clocks

additionalProperties: false

examples:
  - |
    clk_s_c0_flexgen: clk-s-c0-flexgen {
      #clock-cells = <1>;
      compatible = "st,flexgen", "st,flexgen-stih418-c0";

      clocks = <&clk_s_c0_pll0 0>,
               <&clk_s_c0_pll1 0>,
               <&clk_s_c0_quadfs 0>,
               <&clk_s_c0_quadfs 1>,
               <&clk_s_c0_quadfs 2>,
               <&clk_s_c0_quadfs 3>,
               <&clk_sysin>;
    };

...
```

## Documentation/devicetree/bindings/clock/st/st,quadfs.yaml
```yaml
# SPDX-License-Identifier: (GPL-2.0-only OR BSD-2-Clause)
%YAML 1.2
---
$id: http://devicetree.org/schemas/clock/st/st,quadfs.yaml#
$schema: http://devicetree.org/meta-schemas/core.yaml#

title: STMicroelectronics STi platform Digital Frequency synthesizer

maintainers:
  - Patrice Chotard <patrice.chotard@foss.st.com>

description: |
  Binding for a type of quad channel digital frequency synthesizer found on
  certain STMicroelectronics consumer electronics SoC devices.

  This version contains a programmable PLL which can generate up to 216, 432
  or 660MHz (from a 30MHz oscillator input) as the input to the digital
  synthesizers.

properties:
  compatible:
    enum:
      - st,quadfs
      - st,quadfs-d0
      - st,quadfs-d2
      - st,quadfs-d3
      - st,quadfs-pll

  clocks:
    description:
      Specifies the reference clock(s) from which the output frequency is
      derived.
    maxItems: 1

  '#clock-cells':
    const: 1

  clock-output-names:
    maxItems: 1

required:
  - "#clock-cells"
  - compatible
  - clocks

additionalProperties: false

examples:
  - |
    clk_s_c0: clockgen-c@9103000 {
        compatible = "st,clkgen-c32";
        reg = <0x9103000 0x1000>;
        clk_s_c0_quadfs: clk-s-c0-quadfs {
            #clock-cells = <1>;
            compatible = "st,quadfs-pll";
            clocks = <&clk_sysin>;
        };
    };

...
```

## Documentation/devicetree/bindings/cpufreq/cpufreq-dt.yaml
```yaml
# SPDX-License-Identifier: (GPL-2.0-only OR BSD-2-Clause)
%YAML 1.2
---
$id: http://devicetree.org/schemas/cpufreq/cpufreq-dt.yaml#
$schema: http://devicetree.org/meta-schemas/core.yaml#

title: Generic CPUFreq driver

description: |
  It is a generic DT based cpufreq driver for frequency management.  It
  supports both uniprocessor (UP) and symmetric multiprocessor (SMP) systems
  which share clock and voltage across all CPUs.

  Both required and optional properties listed below must be defined under node
  /cpus/cpu@0.

properties:
  operating-points:
    description: |
      Refer to Documentation/devicetree/bindings/opp/opp-v1.yaml for details.
      OPPs *must* be supplied either via DT, i.e. this property, or populated
      at runtime.

  clock-latency:
    description: |
      Specify the possible maximum transition latency for clock, in unit of
      nanoseconds.

  voltage-tolerance:
    description: the CPU voltage tolerance in percentage.

  "#cooling-cells":
    description: |
     Please refer to
     Documentation/devicetree/bindings/thermal/thermal-cooling-devices.yaml.

examples:
  - |

    cpus {
        #address-cells = <1>;
        #size-cells = <0>;

        cpu@0 {
            compatible = "arm,cortex-a9";
            reg = <0>;
            next-level-cache = <&L2>;
            operating-points = <
                /* kHz    uV */
                792000  1100000
                396000  950000
                198000  850000>;
            clock-latency = <61036>; /* two CLK32 periods */
            #cooling-cells = <2>;
        };

        cpu@1 {
            compatible = "arm,cortex-a9";
            reg = <1>;
            next-level-cache = <&L2>;
        };

        cpu@2 {
            compatible = "arm,cortex-a9";
            reg = <2>;
            next-level-cache = <&L2>;
        };

        cpu@3 {
            compatible = "arm,cortex-a9";
            reg = <3>;
            next-level-cache = <&L2>;
        };
    };
```

## Documentation/devicetree/bindings/cpufreq/sti-cpufreq.yaml
```yaml
# SPDX-License-Identifier: (GPL-2.0-only OR BSD-2-Clause)
%YAML 1.2
---
$id: http://devicetree.org/schemas/thermal/st,stih407-thermal.yaml#
$schema: http://devicetree.org/meta-schemas/core.yaml#

title: STMicroelectronics STi CPUFreq

maintainers:
  - Lee Jones <lee@kernel.org>

description: |

  ST's CPUFreq driver attempts to read 'process' and 'version' attributes from
  the SoC, then supplies the OPP framework with 'prop' and 'supported hardware'
  information respectively.  The framework is then able to read the DT and
  operate in the usual way.

properties:
  compatible:
    const: st,stih407-thermal

  reg:
    maxItems: 1

  clocks:
    maxItems: 1

  clock-names:
    items:
      - const: thermal

  interrupts:
    description:
      For thermal sensors for which no interrupt has been defined, a polling
      delay of 1000ms will be used to read the temperature from device.
    maxItems: 1

  '#thermal-sensor-cells':
    const: 0

required:
  - compatible
  - reg
  - clocks
  - clock-names

unevaluatedProperties: false

examples:
  - |
    #include <dt-bindings/interrupt-controller/arm-gic.h>
    temperature-sensor@91a0000 {
        compatible = "st,stih407-thermal";
        reg = <0x91a0000 0x28>;
        clock-names = "thermal";
        clocks = <&CLK_SYSIN>;
        interrupts = <GIC_SPI 205 IRQ_TYPE_EDGE_RISING>;
        #thermal-sensor-cells = <0>;
    };
...
```
